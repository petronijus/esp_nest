## main/Kconfig.projbuild
```kconfig
menu "WiFi Configuration"

    config WIFI_SSID
        string "WiFi SSID"
        default "myssid"
        help
            SSID (network name) to connect to.

    config WIFI_PASSWORD
        string "WiFi Password"
        default "mypassword"
        help
            WiFi password (WPA or WPA2) for the network.

    config WIFI_MAX_RETRY
        int "Maximum retry attempts"
        default 5
        help
            Number of retries before giving up on WiFi connection.

endmenu

menu "MQTT Configuration"

    config MQTT_BROKER_URI
        string "MQTT Broker URI"
        default "mqtt://mqtt.home.arpa"
        help
            URI of the MQTT broker (e.g. mqtt://host:1883).

    config MQTT_USERNAME
        string "MQTT Username"
        default ""
        help
            Username for MQTT broker authentication.

    config MQTT_PASSWORD
        string "MQTT Password"
        default ""
        help
            Password for MQTT broker authentication.

endmenu

menu "MQTT Topics (external devices)"

    config TOPIC_FAN
        string "Fan topic"
        default "home/fan"
        help
            Retained text topic for a fan (payloads: Off/low/medium/high).

    config TOPIC_LIGHTS
        string "Lights base topic (zigbee2mqtt group)"
        default "zigbee2mqtt/lights"
        help
            Base topic of a zigbee2mqtt light group. "/set" and "/get"
            are appended automatically.

    config TOPIC_STEREO_VOL
        string "Stereo volume base topic"
        default "home/stereo/volume"
        help
            Base topic for relative stereo volume. "/set" is appended;
            payloads are UP/DOWN, typically bridged to IR by an automation.

endmenu

menu "Blinds (ESPHome RF cover bridge)"

    config TOPIC_BLINDS_PREFIX
        string "Blinds MQTT prefix"
        default "blinds/cover"
        help
            MQTT prefix of the ESPHome cover bridge. Member and group topics
            are built as <prefix>/<group>_<n>/position/{state,command} and
            <prefix>/<group>_group/command.

    config TOPIC_BLINDS_GROUP_A
        string "Blinds group A id"
        default "group_a"
        help
            Topic id of the first blinds group (three member covers _1.._3).

    config TOPIC_BLINDS_GROUP_B
        string "Blinds group B id"
        default "group_b"
        help
            Topic id of the second blinds group (three member covers _1.._3).

    config TOPIC_BLINDS_LABEL_A
        string "Blinds group A on-screen label"
        default "A"
        help
            Label shown on the blinds page for group A.

    config TOPIC_BLINDS_LABEL_B
        string "Blinds group B on-screen label"
        default "B"
        help
            Label shown on the blinds page for group B.

endmenu
```

## sdkconfig.defaults
```kconfig
# ========================
# Target: ESP32-S3
# ========================
CONFIG_IDF_TARGET="esp32s3"

# ========================
# Flash
# ========================
CONFIG_ESPTOOLPY_FLASHSIZE_16MB=y
CONFIG_ESPTOOLPY_FLASHMODE_QIO=y
CONFIG_ESPTOOLPY_FLASHFREQ_80M=y

# ========================
# Partition Table
# ========================
CONFIG_PARTITION_TABLE_CUSTOM=y
CONFIG_PARTITION_TABLE_CUSTOM_FILENAME="partitions.csv"

# ========================
# PSRAM (Octal, 8 MB)
# ========================
CONFIG_SPIRAM=y
CONFIG_SPIRAM_MODE_OCT=y
CONFIG_SPIRAM_SPEED_80M=y

# ========================
# CPU
# ========================
CONFIG_ESP_DEFAULT_CPU_FREQ_MHZ_240=y

# ========================
# FreeRTOS
# ========================
CONFIG_FREERTOS_HZ=1000

# ========================
# LVGL (via component manager)
# ========================
CONFIG_LV_USE_LOG=y
CONFIG_LV_LOG_LEVEL_WARN=y
CONFIG_LV_FONT_MONTSERRAT_24=y
CONFIG_LV_COLOR_DEPTH_16=y
CONFIG_LV_USE_PERF_MONITOR=y

# ========================
# LCD RGB Panel
# ========================
CONFIG_LCD_RGB_ISR_IRAM_SAFE=y

# ========================
# WiFi
# ========================
CONFIG_WIFI_MAX_RETRY=5
# SSID and password are in secrets.defaults (gitignored)

# ========================
# MQTT
# ========================
CONFIG_MQTT_BROKER_URI="mqtt://mqtt.home.arpa"
# Username and password are in secrets.defaults (gitignored)

# ========================
# HTTP Server (for OTA)
# ========================
CONFIG_HTTPD_MAX_REQ_HDR_LEN=1024
```
